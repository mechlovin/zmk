## app/boards/arm/atreus62/Kconfig.board
```kconfig
# Copyright (c) 2024 Mechlovin'
# SPDX-License-Identifier: MIT

config BOARD_ATREUS62
    bool "atreus62"
    depends on SOC_NRF52840_QIAA
```

## app/boards/arm/atreus62/Kconfig.defconfig
```kconfig
# Copyright (c) 2024 Mechlovin'
# SPDX-License-Identifier: MIT

if BOARD_ATREUS62

config ZMK_KEYBOARD_NAME
    default "atreus62"

if USB

config USB_NRFX
	default y

config USB_DEVICE_STACK
	default y

endif # USB

config BT_CTLR
    default BT

config ZMK_STUDIO
    default y

endif # BOARD_ATREUS62
```

## app/boards/arm/bleu60/Kconfig.board
```kconfig
# Copyright (c) 2024 Mechlovin'
# SPDX-License-Identifier: MIT

config BOARD_BLEU60
    bool "bleu60"
    depends on SOC_NRF52840_QIAA
```

## app/boards/arm/bleu60/Kconfig.defconfig
```kconfig
# Copyright (c) 2024 Mechlovin'
# SPDX-License-Identifier: MIT

if BOARD_BLEU60

config ZMK_KEYBOARD_NAME
    default "bleu60"

if USB

config USB_NRFX
    default y

config USB_DEVICE_STACK
    default y

endif # USB

config BT_CTLR
    default BT

endif # BOARD_BLEU60
```

## app/boards/shields/bleu60/Kconfig.defconfig
```kconfig
# Copyright (c) 2024 The ZMK Contributors
# SPDX-License-Identifier: MIT

if SHIELD_BLEU60

config ZMK_KEYBOARD_NAME
    default "bleu60"

endif
```

## app/boards/shields/bleu60/Kconfig.shield
```kconfig
# Copyright (c) 2024 The ZMK Contributors
# SPDX-License-Identifier: MIT

config SHIELD_BLEU60
    def_bool $(shields_list_contains,bleu60)
```
